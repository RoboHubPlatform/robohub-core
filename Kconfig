## Kconfig
```kconfig
# robohub-core Kconfig
# The application runtime and the sizes of its tables.

menu "RoboHub Core runtime"

config RH_CORE
    bool "Application runtime"
    default n
    help
      The application runtime: the inter-module event bus, the cooperative
      scheduler, the application lifecycle and diagnostics. A program that is
      more than one module selects it and registers its applications.

config RH_CORE_MAX_SUBSCRIBERS
    int "Event subscriptions"
    default 16
    help
      How many subscriptions the event bus holds at once.

config RH_CORE_MAX_TASKS
    int "Periodic tasks"
    default 8
    help
      How many periodic tasks the scheduler holds at once.

config RH_CORE_MAX_APPS
    int "Applications"
    default 4
    help
      How many applications the lifecycle holds at once.

config RH_CORE_TICK_MS
    int "Idle tick (ms)"
    default 10
    help
      The longest the loop waits before looking for work again, in
      milliseconds. A shorter tick is a more responsive idle and more power.

config RH_CORE_TIMER_NAME
    string "Timer instance"
    default "system_timer"
    help
      The registry name of the timer the runtime takes its clock from.

config RH_CORE_TASK_STACK
    int "Task stack (bytes)"
    default 2048
    help
      The stack a periodic task is given when an operating system runs it as a
      thread.

config RH_CORE_TASK_PRIORITY
    int "Task priority"
    default 1
    help
      The priority a periodic task's thread is given, on the kernel's own scale.

config RH_CORE_MAIN_STACK
    int "Loop stack (bytes)"
    default 4096
    help
      The stack the runtime's own loop thread is given, in bytes.

config RH_CORE_MAIN_PRIORITY
    int "Loop priority"
    default 2
    help
      The priority of the runtime's loop thread, above the tasks it wakes.

endmenu
```
